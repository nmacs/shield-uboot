## board/zixlink/coffee/Kconfig
```kconfig
if TARGET_ZIXLINK_COFFEE

config SYS_BOARD
	default "coffee"

config SYS_VENDOR
	default "zixlink"

config SYS_CONFIG_NAME
	default "zixlink_coffee"

endif
```

## board/zixlink/router/Kconfig
```kconfig
if TARGET_ZIXLINK_ROUTER

config SYS_BOARD
	default "router"

config SYS_VENDOR
	default "zixlink"

config SYS_CONFIG_NAME
	default "zixlink_router"

endif
```

## board/zixlink/shield2/Kconfig
```kconfig
if TARGET_ZIXLINK_SHIELD2

config SYS_BOARD
	default "shield2"

config SYS_VENDOR
	default "zixlink"

config SYS_CONFIG_NAME
	default "zixlink_shield2"

endif

if TARGET_ZIXLINK_SHIELD2_1

config SYS_BOARD
	default "shield2"

config SYS_VENDOR
	default "zixlink"

config SYS_CONFIG_NAME
	default "zixlink_shield2.1"

config ZIXLINK_SHIELD2_1_MANUFACTURING
	bool "Manufacturing Bootloader"
	default n

endif


if TARGET_ZIXLINK_SHIELD2_2

config SYS_BOARD
	default "shield2"

config SYS_VENDOR
	default "zixlink"

config SYS_CONFIG_NAME
	default "zixlink_shield2.2"

config ZIXLINK_SHIELD2_2_MANUFACTURING
	bool "Manufacturing Bootloader"
	default n

endif
```

## configs/zixlink_coffee_defconfig
```kconfig
CONFIG_ARM=y
CONFIG_ARCH_MX6=y
CONFIG_TARGET_ZIXLINK_COFFEE=y
CONFIG_SYS_EXTRA_OPTIONS="IMX_CONFIG=board/zixlink/coffee/imximage.cfg"
CONFIG_SYS_TEXT_BASE=0x87800000
CONFIG_BOOTDELAY=3
CONFIG_SYS_CONSOLE_IS_IN_ENV=y
CONFIG_BOARD_EARLY_INIT_F=y
CONFIG_OF_LIBFDT=y
CONFIG_HUSH_PARSER=y
CONFIG_CMD_BOOTZ=y
CONFIG_CMD_MEMTEST=y
CONFIG_CMD_DHCP=y
CONFIG_CMD_PING=y
CONFIG_CMD_BMP=y
CONFIG_CMD_CACHE=y
CONFIG_CMD_FS_GENERIC=y
# CONFIG_CMD_BOOTEFI is not set
# CONFIG_EFI_LOADER is not set
CONFIG_NR_DRAM_BANKS=1

CONFIG_PHYLIB=y
CONFIG_PHY_MICREL=y
CONFIG_SECURE_BOOT=y

CONFIG_CMD_MTDPARTS=y

#CONFIG_SPI_FLASH=y
#CONFIG_SPI_FLASH_MACRONIX=y

CONFIG_FIT=y
CONFIG_FIT_SIGNATURE=y
CONFIG_FSL_CAAM=y

CONFIG_DM=y
CONFIG_RSA=y
CONFIG_OF_CONTROL=y
CONFIG_OF_SEPARATE=y

CONFIG_MTD=y
CONFIG_MTDIDS_DEFAULT="nand0=gpmi-nand,nor1=nor1"
CONFIG_MTD_UBI=y
CONFIG_CMD_UBI=y
CONFIG_NAND=y
CONFIG_NAND_MXS=y
CONFIG_FSL_USDHC=y
```

## configs/zixlink_shield2.1_defconfig
```kconfig
CONFIG_ARM=y
CONFIG_ARCH_MX6=y
CONFIG_TARGET_ZIXLINK_SHIELD2_1=y
CONFIG_SYS_EXTRA_OPTIONS="IMX_CONFIG=board/zixlink/shield2/imximage.cfg"
CONFIG_SYS_TEXT_BASE=0x87800000
CONFIG_BOOTDELAY=0
CONFIG_SYS_CONSOLE_IS_IN_ENV=y
CONFIG_BOARD_EARLY_INIT_F=y
CONFIG_OF_LIBFDT=y
CONFIG_HUSH_PARSER=y
CONFIG_CMD_FS_GENERIC=y
CONFIG_NR_DRAM_BANKS=1

CONFIG_SECURE_BOOT=y
CONFIG_AUTOBOOT=y
CONFIG_AUTOBOOT_KEYED=y
CONFIG_AUTOBOOT_PROMPT="Autoboot in %d seconds\n"
CONFIG_AUTOBOOT_DELAY_STR="stop"

CONFIG_USB=y
CONFIG_USB_EHCI_HCD=y
CONFIG_USB_EHCI_MX6=y
CONFIG_USB_STORAGE=y
CONFIG_CMD_USB=y
#CONFIG_CMD_USB_MASS_STORAGE=y

#CONFIG_SPI_FLASH=y
#CONFIG_SPI_FLASH_MACRONIX=y

CONFIG_FIT=y
CONFIG_FIT_SIGNATURE=y
CONFIG_FSL_CAAM=y

CONFIG_DM=y
CONFIG_RSA=y
CONFIG_OF_CONTROL=y
CONFIG_OF_SEPARATE=y

CONFIG_FSL_USDHC=y
CONFIG_CMD_MMC=y

CONFIG_PARTITIONS=y
CONFIG_MAC_PARTITION=y
CONFIG_DOS_PARTITION=y
CONFIG_ISO_PARTITION=y
CONFIG_EFI_PARTITION=y
CONFIG_CMD_EXT4=y
CONFIG_CMD_FAT=y
```

## configs/zixlink_shield2_defconfig
```kconfig
CONFIG_ARM=y
CONFIG_ARCH_MX6=y
CONFIG_TARGET_ZIXLINK_SHIELD2=y
CONFIG_SYS_EXTRA_OPTIONS="IMX_CONFIG=board/zixlink/shield2/imximage.cfg"
CONFIG_SYS_TEXT_BASE=0x87800000
CONFIG_BOOTDELAY=0
CONFIG_SYS_CONSOLE_IS_IN_ENV=y
CONFIG_BOARD_EARLY_INIT_F=y
CONFIG_OF_LIBFDT=y
CONFIG_HUSH_PARSER=y
CONFIG_CMD_FS_GENERIC=y
CONFIG_NR_DRAM_BANKS=1

CONFIG_SECURE_BOOT=y

#CONFIG_SPI_FLASH=y
#CONFIG_SPI_FLASH_MACRONIX=y

CONFIG_FIT=y
CONFIG_FIT_SIGNATURE=y
CONFIG_FSL_CAAM=y

CONFIG_DM=y
CONFIG_RSA=y
CONFIG_OF_CONTROL=y
CONFIG_OF_SEPARATE=y

CONFIG_FSL_USDHC=y
CONFIG_CMD_MMC=y

CONFIG_PARTITIONS=y
CONFIG_MAC_PARTITION=y
CONFIG_DOS_PARTITION=y
CONFIG_ISO_PARTITION=y
CONFIG_EFI_PARTITION=y
CONFIG_CMD_EXT4=y
CONFIG_CMD_FAT=y
```
